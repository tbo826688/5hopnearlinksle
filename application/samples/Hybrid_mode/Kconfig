## application/samples/Hybrid_mode/Kconfig
```kconfig
# samples/Hybrid_mode/Kconfig

# 定义具体的 Sample 选项
config SAMPLE_SUPPORT_SLE_UART_HYBRID_SAMPLE
    bool
    prompt "Support SLE UART Hybrid Sample."
    default n
    depends on ENABLE_HYBRID_MODE_SAMPLE
    help
        This option means support SLE UART Hybrid Sample.

# 如果选中了，就引用 sle_uart 文件夹下的 Kconfig 以显示更详细的配置（如 Server/Client 选项）
if SAMPLE_SUPPORT_SLE_UART_HYBRID_SAMPLE
    osource "application/samples/Hybrid_mode/sle_uart/Kconfig"
endif
```

## application/samples/Hybrid_mode/sle_uart/Kconfig
```kconfig
#===============================================================================
# @brief    Kconfig file.
# Copyright (c) @CompanyNameMagicTag 2023-2023. All rights reserved.
#===============================================================================

# 【修正】depends on 必须对应 samples/Hybrid_mode/Kconfig 中的总开关名
config SLE_UART_BUS
    int "Set the UART BUS of the current sample"
    default 0
    depends on SAMPLE_SUPPORT_SLE_UART_HYBRID_SAMPLE
    help
        This option means the UART BUS of the current sample.

config UART_TXD_PIN
    int "Choose UART TXD pin"
    depends on SAMPLE_SUPPORT_SLE_UART_HYBRID_SAMPLE
    default 17

config UART_RXD_PIN
    int "Choose UART RXD pin"
    depends on SAMPLE_SUPPORT_SLE_UART_HYBRID_SAMPLE
    default 18

choice
    prompt "Select SLE UART Type"
    default SAMPLE_SUPPORT_SLE_UART_HYBRID_SERVER_MODE

    # 加上 _HYBRID_ 前缀，避免冲突
    config SAMPLE_SUPPORT_SLE_UART_HYBRID_SERVER_MODE
        bool "Enable SLE UART Server sample"

    config SAMPLE_SUPPORT_SLE_UART_HYBRID_CLIENT_MODE
        bool "Enable SLE UART Client sample"
        
    # 改名为 _HYBRID_MODE，解决 "Dependency loop" 死循环
    config SAMPLE_SUPPORT_SLE_UART_HYBRID_MODE
        bool "Enable SLE UART Hybrid (Server & Client) sample"
endchoice

# 依赖逻辑同步更新为新名字
config SUPPORT_SLE_PERIPHERAL
    bool
    default y if (SAMPLE_SUPPORT_SLE_UART_HYBRID_SERVER_MODE || SAMPLE_SUPPORT_SLE_UART_HYBRID_MODE)

config SUPPORT_SLE_CENTRAL
    bool
    default y if (SAMPLE_SUPPORT_SLE_UART_HYBRID_CLIENT_MODE || SAMPLE_SUPPORT_SLE_UART_HYBRID_MODE)
```

## application/samples/Kconfig
```kconfig
#===============================================================================
# @brief    Kconfig file.
# Copyright (c) @CompanyNameMagicTag 2023-2023. All rights reserved.
#===============================================================================

config ENABLE_PERIPHERAL_SAMPLE
    bool
    prompt "Enable the Sample of peripheral."
    default n
    depends on SAMPLE_ENABLE
    help
        This option means enable the sample of peripheral.

if ENABLE_PERIPHERAL_SAMPLE
osource "application/samples/peripheral/Kconfig"
endif

config ENABLE_WIFI_SAMPLE
    bool
    prompt "Enable the Sample of WIFI."
    default n
    depends on SAMPLE_ENABLE
    help
        This option means enable the sample of WIFI.

if ENABLE_WIFI_SAMPLE
osource "application/samples/wifi/Kconfig"
endif

config ENABLE_PRODUCTS_SAMPLE
    bool
    prompt "Enable the Sample of products."
    default n
    depends on SAMPLE_ENABLE
    help
        This option means enable the sample of products.

if ENABLE_PRODUCTS_SAMPLE
osource "application/samples/products/Kconfig"
endif
# 【新增】定义混合模式的总开关
config ENABLE_HYBRID_MODE_SAMPLE
    bool
    prompt "Enable the Sample of Hybrid Mode."
    default n
    depends on SAMPLE_ENABLE
    help
        This option means enable the sample of hybrid mode.

# 引用下一级的 Kconfig
if ENABLE_HYBRID_MODE_SAMPLE
    osource "application/samples/Hybrid_mode/Kconfig"
endif
```

## application/samples/products/Kconfig
```kconfig
#===============================================================================
# @brief    Kconfig file.
# Copyright (c) @CompanyNameMagicTag 2023-2023. All rights reserved.
#===============================================================================
config ENABLE_ALL_PRODUCTS_SAMPLE
    bool
    prompt "Enable all the sample of product, it's just for build."
    default n
    depends on ENABLE_PRODUCTS_SAMPLE
    select SAMPLE_SUPPORT_BLE_UART
    select SAMPLE_SUPPORT_SLE_UART
    select SAMPLE_SUPPORT_SLE_UART_1_VS_8
    select SAMPLE_SUPPORT_SLE_GETAWAY
    help
        This option means enable all the sample of product, it is just for build.



config SAMPLE_SUPPORT_BLE_UART
    bool
    prompt "Support BLE UART sample."
    default n
    depends on ENABLE_PRODUCTS_SAMPLE
    help
        This option means support BLE UART Sample.

if SAMPLE_SUPPORT_BLE_UART
menu "BLE UART Sample Configuration"
    osource "application/samples/products/ble_uart/Kconfig"
endmenu
endif



config SAMPLE_SUPPORT_SLE_UART
    bool
    prompt "Support SLE UART sample."
    default n
    depends on ENABLE_PRODUCTS_SAMPLE
    help
        This option means support SLE UART Sample.

if SAMPLE_SUPPORT_SLE_UART
menu "SLE UART Sample Configuration"
    osource "application/samples/products/sle_uart/Kconfig"
endmenu
endif

# 在 products/Kconfig 文件末尾添加：

config SAMPLE_SUPPORT_ROUTE
    bool
    prompt "Support SLE Route sample."
    default n
    depends on ENABLE_PRODUCTS_SAMPLE
    help
        This option means support the SLE route sample.

if SAMPLE_SUPPORT_ROUTE
menu "SLE Route Sample Configuration"
    osource "application/samples/products/route/Kconfig"
endmenu
endif

config SAMPLE_SUPPORT_ROUTE_BRIDGE
    bool
    prompt "Support SLE dual-board route bridge sample."
    default n
    depends on ENABLE_PRODUCTS_SAMPLE && !SAMPLE_SUPPORT_ROUTE
    help
        Split each logical router into a pure SLE client board and a pure
        SLE server board connected through UART1.

if SAMPLE_SUPPORT_ROUTE_BRIDGE
menu "SLE Dual-board Route Bridge Configuration"
    osource "application/samples/products/route_bridge/Kconfig"
endmenu
endif

config SLE_TWO_HOP_VALIDATION_MODE
    bool
    prompt "Enable SLE two-hop validation mode (Node1 -> R1 bridge -> Node6)"
    default n
    depends on (SAMPLE_SUPPORT_SLE_UART && SAMPLE_FILE_TRANSFER_MODE) || \
        (SAMPLE_SUPPORT_ROUTE_BRIDGE && ROUTE_BRIDGE_NODE_ID = 1)
    help
        Keep this option disabled for the complete five-hop topology.
        Enable it in the Node1, Node6, R1-RX and R1-TX builds to validate
        Node1 -> R1-RX -> UART1 -> R1-TX -> Node6. In this mode R1-TX
        advertises SLE_END and Node6 accepts an R1-only diagnostic path.





config SAMPLE_SUPPORT_SLE_UART_1_VS_8
    bool
    prompt "Support SLE UART 1 vs 8 sample."
    default n
    depends on ENABLE_PRODUCTS_SAMPLE
    help
        This option means support SLE UART  1 vs 8  Sample.

if SAMPLE_SUPPORT_SLE_UART_1_VS_8
menu "SLE UART  1 vs 8  Sample Configuration"
    osource "application/samples/products/sle_uart_1_vs_8/Kconfig"
endmenu
endif

config SAMPLE_SUPPORT_SLE_GETAWAY
    bool
    prompt "Support SLE GATEWAY sample."
    default n
    depends on ENABLE_PRODUCTS_SAMPLE
    help
        This option means support SLE GATEWAY Sample.

if SAMPLE_SUPPORT_SLE_GETAWAY
menu "SLE GATEWAY Sample Configuration"
    osource "application/samples/products/sle_gateway/Kconfig"
endmenu
endif
```

## application/samples/products/route/Kconfig
```kconfig
#===============================================================================
# @brief    Kconfig file for SLE Route
#===============================================================================

choice
    prompt "Select SLE route role"
    default SAMPLE_SUPPORT_ROUTE_ALL

    config SAMPLE_SUPPORT_ROUTE_SERVER
        bool "Enable SLE route Server role."

    config SAMPLE_SUPPORT_ROUTE_CLIENT
        bool "Enable SLE route Client role."

    config SAMPLE_SUPPORT_ROUTE_ALL
        bool "Enable SLE Server & Client (single-board R1-R4)."
endchoice

config ROUTE_NODE_ID
    int "Logical router id (R1=1, R2=2, R3=3, R4=4)"
    range 1 4
    default 1
    depends on SAMPLE_SUPPORT_ROUTE_ALL
    help
        Select the identity of this single-board router image. The value also
        determines the upstream name to scan and the downstream name to
        advertise, so each of R1, R2, R3 and R4 must be built separately.

config ROUTE_OUTDOOR_LONG_RANGE
    bool "Use outdoor long-range supervision timeout"
    default y
    help
        Keep the connection alive across short outdoor fades. Disable only for
        indoor debugging that requires quicker disconnect detection.

config SUPPORT_SLE_PERIPHERAL
    bool
    default y if (SAMPLE_SUPPORT_ROUTE_SERVER || SAMPLE_SUPPORT_ROUTE_ALL)

config SUPPORT_SLE_CENTRAL
    bool
    default y if (SAMPLE_SUPPORT_ROUTE_CLIENT || SAMPLE_SUPPORT_ROUTE_ALL)
```

## application/samples/products/route_bridge/Kconfig
```kconfig
#===============================================================================
# @brief    Kconfig for the dual-board SLE route bridge
#===============================================================================

choice
    prompt "Select the board side"
    default SAMPLE_SUPPORT_ROUTE_BRIDGE_RX

    config SAMPLE_SUPPORT_ROUTE_BRIDGE_RX
        bool "RX board: pure SLE Client -> UART1"

    config SAMPLE_SUPPORT_ROUTE_BRIDGE_TX
        bool "TX board: UART1 -> pure SLE Server"
endchoice

config ROUTE_BRIDGE_NODE_ID
    int
    prompt "Logical router id (R1=1, R2=2, R3=3, R4=4)"
    range 1 4
    default 1

config ROUTE_BRIDGE_UART_BUS
    int
    prompt "Bridge UART bus"
    range 1 1
    default 1

config ROUTE_BRIDGE_UART_TX_PIN
    int
    prompt "Bridge UART TX pin"
    range 15 15
    default 15

config ROUTE_BRIDGE_UART_RX_PIN
    int
    prompt "Bridge UART RX pin"
    range 16 16
    default 16

config ROUTE_BRIDGE_UART_BAUDRATE
    int
    prompt "Bridge UART baud rate"
    range 115200 4000000
    default 921600

config ROUTE_BRIDGE_OUTDOOR_LONG_RANGE
    bool
    prompt "Use the outdoor supervision timeout"
    default y

config SUPPORT_SLE_PERIPHERAL
    bool
    default y if SAMPLE_SUPPORT_ROUTE_BRIDGE_TX

config SUPPORT_SLE_CENTRAL
    bool
    default y if SAMPLE_SUPPORT_ROUTE_BRIDGE_RX
```

## application/samples/products/sle_uart/Kconfig
```kconfig
#===============================================================================
# @brief    Kconfig file.
# Copyright (c) @CompanyNameMagicTag 2023-2023. All rights reserved.
#===============================================================================

config SLE_UART_BUS
    int
    prompt "Set the UART BUS of the currrent sample."
    default 0
    depends on SAMPLE_SUPPORT_SLE_UART
    help
        This option means the UART BUS of the currrent sample.
config UART_TXD_PIN
    int
    prompt "Choose UART TXD pin."
    depends on SAMPLE_SUPPORT_SLE_UART
    default 17

config UART_RXD_PIN
    int
    prompt "Choose UART RXD pin."
    depends on SAMPLE_SUPPORT_SLE_UART
    default 18

choice
    prompt "Select sle uart type"
    default SAMPLE_SUPPORT_SLE_UART_SERVER
    config SAMPLE_SUPPORT_SLE_UART_SERVER
        bool "Enable SLE UART Server sample."
    config SAMPLE_SUPPORT_SLE_UART_CLIENT
        bool "Enable SLE UART Client sample."
    # 【新增】增加主从一体选项
    config SAMPLE_SUPPORT_SLE_UART_ALL
        bool "Enable SLE UART Server & Client sample."
endchoice

config SAMPLE_FILE_TRANSFER_MODE
    bool "Enable end-to-end file transfer mode (UART<->SLE 5-hop)"
    depends on SAMPLE_SUPPORT_SLE_UART
    default n
    help
        When enabled, Node 1 reads bytes from CONFIG_SLE_UART_BUS and forwards
        them with a 12-byte header (magic+seq+CRC16) over the 5-hop link;
        Node 6 verifies CRC and writes verified payloads back to its UART.
        UART runs at 921600 baud. When disabled, the legacy 1400-byte
        synthetic throughput stream is used.

config SUPPORT_SLE_PERIPHERAL
    bool
    # 【修改】Server 或 All 模式支持 Peripheral
    default y if (SAMPLE_SUPPORT_SLE_UART_SERVER || SAMPLE_SUPPORT_SLE_UART_ALL)

config SUPPORT_SLE_CENTRAL
    bool
    # 【修改】Client 或 All 模式支持 Central
    default y if (SAMPLE_SUPPORT_SLE_UART_CLIENT || SAMPLE_SUPPORT_SLE_UART_ALL)
```

## application/samples/products/sle_uart_sever/Kconfig
```kconfig
#===============================================================================
# @brief    Kconfig file for SLE UART SEVER
#===============================================================================

# [修改] 变量名增加 _SEVER 后缀
config SLE_UART_SEVER_BUS
    int
    prompt "Set the UART BUS of the currrent sample."
    default 0
    # [修改] 依赖项改为新的顶层宏
    depends on SAMPLE_SUPPORT_SLE_UART_SEVER
    help
        This option means the UART BUS of the currrent sample.

# [修改] 变量名增加 _SEVER 后缀
config UART_SEVER_TXD_PIN
    int
    prompt "Choose UART TXD pin."
    depends on SAMPLE_SUPPORT_SLE_UART_SEVER
    default 17

# [修改] 变量名增加 _SEVER 后缀
config UART_SEVER_RXD_PIN
    int
    prompt "Choose UART RXD pin."
    depends on SAMPLE_SUPPORT_SLE_UART_SEVER
    default 18

choice
    prompt "Select sle uart type"
    # [修改] 默认值改为新的Server宏
    default SAMPLE_SUPPORT_SLE_UART_SEVER_SERVER
    
    # [修改] Server宏重命名
    config SAMPLE_SUPPORT_SLE_UART_SEVER_SERVER
        bool "Enable SLE UART Server sample."
    
    # [修改] Client宏重命名
    config SAMPLE_SUPPORT_SLE_UART_SEVER_CLIENT
        bool "Enable SLE UART Client sample."
    
    # [修改] ALL宏重命名
    config SAMPLE_SUPPORT_SLE_UART_SEVER_ALL
        bool "Enable SLE UART Server & Client sample."
endchoice

config SUPPORT_SLE_PERIPHERAL
    bool
    # [修改] 这里的逻辑是追加，如果选中了新的SERVER或ALL，也支持Peripheral
    # 注意：select 语句通常在顶层 Kconfig 处理，这里使用 default if
    default y if (SAMPLE_SUPPORT_SLE_UART_SEVER_SERVER || SAMPLE_SUPPORT_SLE_UART_SEVER_ALL)

config SUPPORT_SLE_CENTRAL
    bool
    # [修改] 同上
    default y if (SAMPLE_SUPPORT_SLE_UART_SEVER_CLIENT || SAMPLE_SUPPORT_SLE_UART_SEVER_ALL)
```
